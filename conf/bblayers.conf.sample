## conf/bblayers.conf.sample
```bitbake
# LAYER_CONF_VERSION is increased each time build/conf/bblayers.conf
# changes incompatibly
LCONF_VERSION = "6"

BBPATH = "${TOPDIR}"
BBFILES ?= ""


BBLAYERS ?= " \
	##COREBASE##/meta \
	##COREBASE##/meta-yocto \
	##COREBASE##/meta-yocto-bsp \
	##COREBASE##/meta-java \
	##COREBASE##/meta-mono \
	##COREBASE##/meta-ts/meta-ts7500 \
	##COREBASE##/meta-ts \
	##COREBASE##/meta-openembedded/meta-oe \
	##COREBASE##/meta-openembedded/meta-webserver \
	##COREBASE##/meta-openembedded/meta-networking \
	"

BBFILE_PRIORITY_openembedded-layer = "1"
```

## conf/layer.conf
```bitbake
# We have a conf and classes directory, add to BBPATH
BBPATH .= ":${LAYERDIR}"

# We have a packages directory, add to BBFILES
BBFILES += "${LAYERDIR}/recipes-*/*/*.bb \
            ${LAYERDIR}/recipes-*/*/*.bbappend"

LAYERSERIES_COMPAT_ts = "hardknott"

BBFILE_COLLECTIONS += "ts"
BBFILE_PATTERN_ts := "^${LAYERDIR}/"
BBFILE_PRIORITY_ts = "6"

LAYERDEPENDS_ts = "core freescale-layer"
```

## conf/machine/include/ts4900.inc
```bitbake
# Common settings for ts4900 boards

include conf/machine/include/imx-base.inc
include conf/machine/include/tune-cortexa9.inc

PREFERRED_PROVIDER_virtual/kernel ?= "linux-technologic"
PREFERRED_VERSION_linux-technologic ?= "3.10.53"


SERIAL_CONSOLE = "115200 ttymxc0"

KERNEL_IMAGETYPE = "uImage"

KERNEL_DEVICETREE = "imx6dl-ts4900.dtb imx6q-ts4900.dtb imx6q-ts4900-2.dtb imx6dl-ts4900-2.dtb imx6q-ts4900-9.dtb imx6dl-ts4900-9.dtb imx6q-ts4900-a.dtb imx6dl-ts4900-a.dtb imx6q-ts4900-14.dtb imx6dl-ts4900-14.dtb imx6q-ts7970.dtb imx6dl-ts7970.dtb"

IMAGE_BOOTLOADER = ""
IMAGE_INSTALL += " ts4900-fpga kernel-devicetree linux-firmware"

MACHINE_EXTRA_RRECOMMENDS += "linux-firmware-wl12xx"
MACHINE_FEATURES += " pci wifi bluetooth touchscreen"

# Since I'm including new gpu drivers, override freescale's older version requirement.
PREFERRED_VERSION_xserver-xorg_mx6 = "2:1.15.1"
PREFERRED_VERSION_directfb_mx6 = "1.7.4"
PREFERRED_VERSION_directfb-examples_mx6 = "1.7.0"


# New gl plugin required for new gpu to remove dependency on old vivante driver
PREFERRED_VERSION_gst-fsl-plugin = "4.0.2"
PREFERRED_VERSION_gst1.0-fsl-plugin = "4.0.2"
PREFERRED_VERSION_libfslvpuwrap = "1.0.57"

# mx6 GPU libraries
PREFERRED_PROVIDER_virtual/egl_mx6 = "imx-gpu-viv"
PREFERRED_PROVIDER_virtual/libgles1_mx6q = "imx-gpu-viv"
PREFERRED_PROVIDER_virtual/libgles1_mx6dl = "imx-gpu-viv"
PREFERRED_PROVIDER_virtual/libgles1_mx6sx = "imx-gpu-viv"
PREFERRED_PROVIDER_virtual/libgles1_mx6sl = "mesa"
PREFERRED_PROVIDER_virtual/libgles2_mx6q = "imx-gpu-viv"
PREFERRED_PROVIDER_virtual/libgles2_mx6dl = "imx-gpu-viv"
PREFERRED_PROVIDER_virtual/libgles2_mx6sx = "imx-gpu-viv"
PREFERRED_PROVIDER_virtual/libgles2_mx6sl = "mesa"
PREFERRED_PROVIDER_virtual/libgl_mx6q = "imx-gpu-viv"
PREFERRED_PROVIDER_virtual/libgl_mx6dl = "imx-gpu-viv"
PREFERRED_PROVIDER_virtual/libgl_mx6sx = "imx-gpu-viv"
PREFERRED_PROVIDER_virtual/libgl_mx6sl = "mesa"
PREFERRED_PROVIDER_virtual/libg2d_mx6 = "imx-gpu-viv"
PREFERRED_PROVIDER_virtual/libgal-x11 = "imx-gpu-viv"


PREFERRED_PROVIDER_virtual/fftw = "fftw"
```

## conf/machine/ts4900-dual.conf
```bitbake
#@TYPE: Machine
#@NAME: embeddedTS i.MX6 TS-4900 Duallite
#@SOC: i.MX6DL
#@DESCRIPTION: Machine configuration for i.MX6 TS-4900 Duallite
#@MAINTAINER: Mark Featherston <mark@embeddedTS.com>

include include/ts4900.inc

SOC_FAMILY = "mx6:mx6dl:ts4900"

MACHINE_FEATURES += "wifi alsa screen wifi"

hostname_pn-base-files = "ts-imx6-d"
```

## conf/machine/ts4900-quad.conf
```bitbake
#@TYPE: Machine
#@NAME: Technologic Systems i.MX6 TS-4900 Quad
#@SOC: i.MX6Q
#@DESCRIPTION: Machine configuration for i.MX6 TS-4900 Quad
#@MAINTAINER: Mark Featherston <mark@embeddedarm.com>

include include/ts4900.inc

SOC_FAMILY = "mx6:mx6q:ts4900"

MACHINE_FEATURES += "wifi alsa screen wifi"

hostname_pn-base-files = "ts-imx6-q"
```

## conf/machine/ts4900-solo.conf
```bitbake
#@TYPE: Machine
#@NAME: embeddedTS i.MX6 TS-4900 Solo
#@SOC: i.MX6S
#@DESCRIPTION: Machine configuration for i.MX6 TS-4900 Solo
#@MAINTAINER: Mark Featherston <mark@embeddedTS.com>

include include/ts4900.inc

SOC_FAMILY = "mx6:mx6dl:ts4900"

MACHINE_FEATURES += "wifi alsa screen wifi"

hostname_pn-base-files = "ts-imx6-s"
```

## conf/machine/tsimx6.conf
```bitbake
#@TYPE: Machine
#@NAME: embeddedTS i.MX6 Board
#@SOC: i.MX6
#@DESCRIPTION: Machine configuration for i.MX6
#@MAINTAINER: Mark Featherston <mark@embeddedTS.com>

include conf/machine/include/imx-base.inc
include conf/machine/include/tune-cortexa9.inc

PREFERRED_PROVIDER_virtual/kernel ?= "linux-technologic"
PREFERRED_VERSION_linux-technologic ?= "3.10.53"

SERIAL_CONSOLE = "115200 ttymxc0"

KERNEL_IMAGETYPE = "uImage"

KERNEL_DEVICETREE = "imx6dl-ts4900.dtb imx6q-ts4900.dtb imx6q-ts4900-2.dtb imx6dl-ts4900-2.dtb imx6q-ts4900-9.dtb imx6dl-ts4900-9.dtb imx6q-ts4900-a.dtb imx6dl-ts4900-a.dtb imx6q-ts4900-14.dtb imx6dl-ts4900-14.dtb imx6q-ts7970.dtb imx6dl-ts7970.dtb imx6q-ts7990-lxd.dtb imx6q-ts7990-okaya.dtb imx6q-ts7990-microtips.dtb imx6dl-ts7990-lxd.dtb imx6dl-ts7990-okaya.dtb imx6dl-ts7990-microtips.dtb"

IMAGE_BOOTLOADER = ""
IMAGE_INSTALL += " ts4900-fpga kernel-devicetree linux-firmware ts4900-utils"

MACHINE_EXTRA_RRECOMMENDS += "linux-firmware-wl12xx"
MACHINE_FEATURES += " pci wifi bluetooth touchscreen"

SOC_FAMILY = "mx6:mx6dl:mx6q"

MACHINE_FEATURES += "wifi alsa screen wifi"

hostname_pn-base-files = "ts-imx6"
```

## conf/machine/tsmx28.conf
```bitbake
#@TYPE: Machine
#@NAME: Technologic Systems i.MX28 Board
#@SOC: i.MX28
#@DESCRIPTION: Machine configuration for i.MX28
#@MAINTAINER: Mark Featherston <mark@embeddedarm.com>

include conf/machine/include/mxs-base.inc
SOC_FAMILY = "mxs:mx28"

PREFERRED_PROVIDER_virtual/kernel ?= "linux-ts-mx28"
PREFERRED_VERSION_linux-technologic ?= "3.10.28"

SERIAL_CONSOLE = "115200 ttyAMA0"

KERNEL_IMAGETYPE = "uImage"

KERNEL_DEVICETREE = "imx28-ts7680.dtb imx28-ts7695.dtb"

IMAGE_BOOTLOADER = ""
IMAGE_INSTALL += " kernel-devicetree linux-firmware"

MACHINE_EXTRA_RRECOMMENDS += "linux-firmware-wl12xx"
MACHINE_FEATURES += " apm usbgadget usbhost vfat alsa touchscreen wifi bluetooth"

hostname_pn-base-files = "ts-imx28"

IMAGE_FSTYPES ?= "tar.bz2"
```

## meta-ts471x/conf/layer.conf
```bitbake
# We have a conf and classes directory, add to BBPATH
BBPATH := "${BBPATH}:${LAYERDIR}"

# We have a recipes directory, add to BBFILES
BBFILES := "${BBFILES} ${LAYERDIR}/recipes-*/*/*.bb \
	${LAYERDIR}/recipes-*/*/*.bbappend"

BBFILE_COLLECTIONS += "ts471x"
BBFILE_PATTERN_ts471x := "^${LAYERDIR}/"
BBFILE_PRIORITY_ts471x = "6"
```

## meta-ts471x/conf/machine/ts471x.conf
```bitbake
#@TYPE: Machine
#@NAME: ts471x

#@DESCRIPTION: Machine configuration for ts471x systems

PREFERRED_PROVIDER_virtual/xserver = "xserver-xorg"
XSERVER = "xserver-xorg \
           xf86-input-evdev \
           xf86-input-mouse \
           xf86-input-keyboard"

# Ship all kernel modules by default
MACHINE_EXTRA_RRECOMMENDS = " kernel-modules"

include conf/machine/include/tune-xscale.inc

IMAGE_FSTYPES += "tar.bz2"

SERIAL_CONSOLE = "115200 tsconsole"

PREFERRED_PROVIDER_virtual/kernel ?= "linux-ts471x"
PREFERRED_VERSION_linux-ts471x ?= "2.6.34%"

KERNEL_IMAGETYPE = "vmlinux"

SYSVINIT_ENABLED_GETTYS= ""
MACHINE_FEATURES = "ext2 vfat usbgadget usbhost wifi 3g ppp wlan alsa"
MACHINE_FEATURES_BACKFILL_CONSIDERED = "rtc"
```

## meta-ts4800/conf/layer.conf
```bitbake
# We have a conf and classes directory, add to BBPATH
BBPATH := "${BBPATH}:${LAYERDIR}"

# We have a recipes directory, add to BBFILES
BBFILES := "${BBFILES} ${LAYERDIR}/recipes-*/*/*.bb \
	${LAYERDIR}/recipes-*/*/*.bbappend"

BBFILE_COLLECTIONS += "ts4800"
BBFILE_PATTERN_ts4800 := "^${LAYERDIR}/"
BBFILE_PRIORITY_ts4800 = "6"
```

## meta-ts4800/conf/machine/ts4800.conf
```bitbake
#@TYPE: Machine
#@NAME: ts4800

#@DESCRIPTION: Machine configuration for ts4800 systems

PREFERRED_PROVIDER_virtual/xserver = "xserver-xorg"
PREFERRED_PROVIDER_virtual/libgl ?= "mesa-dri"
PREFERRED_PROVIDER_virtual/libgles1 ?= "mesa-dri"
PREFERRED_PROVIDER_virtual/libgles2 ?= "mesa-dri"
XSERVER = "xserver-xorg \
           xserver-xorg-extension-dri \
           xserver-xorg-extension-dri2 \
           xserver-xorg-extension-glx \
           xserver-xorg-extension-extmod \
           xserver-xorg-extension-dbe \
           xserver-xorg-module-libint10 \
	   mesa-dri-driver-swrast \
	   xf86-input-evdev \
           xf86-input-mouse \
           xf86-video-fbdev \
           xf86-input-keyboard"

# Ship tall kernel modules by default
MACHINE_EXTRA_RRECOMMENDS = " kernel-modules"


# Uncomment the following line to enable the hard floating point abi. Note that
# this breaks some binary libraries and 3D (neither of which ship with
# meta-yocto). For maximum compatibility, leave this disabled.
DEFAULTTUNE ?= "cortexa8hf-neon"
include conf/machine/include/tune-cortexa8.inc

IMAGE_FSTYPES += "tar.bz2"

SERIAL_CONSOLE = "115200 tsconsole"

PREFERRED_PROVIDER_virtual/kernel ?= "linux-ts4800"
PREFERRED_VERSION_linux-ts4800 ?= "2.6.35%"

KERNEL_IMAGETYPE = "zImage"

SYSVINIT_ENABLED_GETTYS= ""
MACHINE_FEATURES = "ext2 vfat usbgadget usbhost wifi 3g ppp wlan alsa"
MACHINE_FEATURES_BACKFILL_CONSIDERED = "rtc"
```

## meta-ts7500/conf/layer.conf
```bitbake
# We have a conf and classes directory, add to BBPATH
BBPATH := "${BBPATH}:${LAYERDIR}"

# We have a recipes directory, add to BBFILES
BBFILES := "${BBFILES} ${LAYERDIR}/recipes-*/*/*.bb \
	${LAYERDIR}/recipes-*/*/*.bbappend"

BBFILE_COLLECTIONS += "ts7500"
BBFILE_PATTERN_ts7500 := "^${LAYERDIR}/"
BBFILE_PRIORITY_ts7500 = "6"

LAYERDEPENDS_ts7500 = "ts"
```

## meta-ts7500/conf/machine/include/tune-ts7500.inc
```bitbake
DEFAULTTUNE ?= "ts7500"

require conf/machine/include/arm/arch-armv4.inc
ABIEXTENESION = "eabi"
TARGET_FPU = "soft"
TUNEVALID[ts7500] = "Enable ts7500 specific processor optimizations(no thumb, soft fload)"
ARM_INSTRUCTION_SET = "arm"
TUNE_CCARGS += "${@bb.utils.contains("TUNE_FEATURES", "ts7500", "-marm -mfloat-abi=soft", "", d)}"

AVAILTUNES += "ts7500"
TUNE_FEATURES_tune-ts7500 = "${TUNE_FEATURES_tune-armv4} no-thumb-interwork ts7500"
PACKAGE_EXTRA_ARCHS_tune-ts7500 = "${PACKAGE_EXTRA_ARCHS_tune-armv4}"
```

## meta-ts7500/conf/machine/ts7500.conf
```bitbake
#@TYPE: Machine
#@NAME: Technologic Systems TS-75xx SBC
#@DESCRIPTION: Machine configuration for Technologic Systems TS-75xx SBC

require conf/machine/include/qemu.inc
require conf/machine/include/tune-ts7500.inc

TARGET_ARCH ?= "arm"
PREFERRED_PROVIDER_virtual/kernel ?= "linux-ts7500"
PREFERRED_VERSION_linux-ts7500 ?= "3.4%"

#BASE_PACKAGE_ARCH = "armv4" 
#TARGET_CFLAGS += "-march=armv4 -mno-thumb-interwork -mno-thumb -mfloat-abi=soft"
#PACKAGE_EXTRA_ARCHS += "armv4"

#require conf/machine/include/tune-arm926ejs.inc
#require conf/machine/include/tune-fa526.inc



KERNEL_IMAGETYPE = "zImage"
SERIAL_CONSOLE = "115200 ttyS0"
SYSVINIT_ENABLED_GETTYS= ""
MACHINE_FEATURES = "ext2 vfat usbgadget usbhost wifi 3g ppp"
MACHINE_FEATURES_BACKFILL_CONSIDERED = "rtc"
```
