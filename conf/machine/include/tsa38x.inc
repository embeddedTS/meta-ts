## conf/machine/include/tsimx93.inc
```bitbake
MACHINEOVERRIDES =. "mx93:tsimx93"

require conf/machine/include/imx-base.inc
require conf/machine/include/arm/armv8-2a/tune-cortexa55.inc

MACHINE_FEATURES += "pci bluetooth"
MACHINE_FEATURES:append:use-nxp-bsp = " optee jailhouse"

PREFERRED_PROVIDER_virtual/kernel ?= "linux-prototype-imx93"
IMX_DEFAULT_KERNEL = "linux-prototype-imx93"
KERNEL_DEVICETREE = " \
    freescale/${KERNEL_DEVICETREE_BASENAME}.dtb \
"

PREFERRED_PROVIDER_u-boot = "u-boot-ts"
IMX_DEFAULT_KERNEL = "linux-prototype-imx93"
IMX_DEFAULT_BOOTLOADER = "u-boot-ts"

PREFERRED_PROVIDER_u-boot = "u-boot-ts"
PREFERRED_PROVIDER_u-boot-mfgtool = "u-boot-ts"
PREFERRED_PROVIDER_u-boot-tools = "u-boot-ts"
PREFERRED_PROVIDER_virtual/bootloader = "u-boot-ts"

LOADADDR = ""
UBOOT_SUFFIX = "bin"
UBOOT_MAKE_TARGET = ""

SPL_BINARY = "spl/u-boot-spl.bin"

UBOOT_CONFIG ??= "sd"
UBOOT_CONFIG[sd]   = "${UBOOT_CONFIG_BASENAME}_defconfig,sdcard"
UBOOT_CONFIG[ecc]  = "${UBOOT_CONFIG_BASENAME}_inline_ecc_defconfig"
UBOOT_CONFIG[ld]   = "${UBOOT_CONFIG_BASENAME}_ld_defconfig"

# Set ATF platform name
ATF_PLATFORM = "imx93"

IMXBOOT_TARGETS = "flash_singleboot"

IMX_BOOT_SOC_TARGET = "iMX9"
IMX_BOOT_SEEK = "32"

# We have to disable SERIAL_CONSOLE due to auto-serial-console
SERIAL_CONSOLES = "115200;ttyLP0"

IMX_DEFAULT_BSP = "nxp"
```

## conf/machine/ts4100.conf
```bitbake
include conf/machine/include/tsimx6ul.inc

KERNEL_DEVICETREE = " \
	nxp/imx/imx6ul-ts4100.dtb \
	nxp/imx/imx6ul-ts4100-7.dtb \
	nxp/imx/imx6ul-ts4100-8.dtb \
	nxp/imx/imx6ul-ts4100-16.dtb "

MACHINE_FEATURES += "tssilo"
MACHINE_ESSENTIAL_EXTRA_RRECOMMENDS += "wilc3000-external-module"
MACHINE_EXTRA_RRECOMMENDS += "ts4100-utils zpu-elf-gcc-armhf"
```

## conf/machine/ts4900.conf
```bitbake
include conf/machine/include/tsimx6.inc

KERNEL_DEVICETREE = " \
	nxp/imx/imx6dl-ts4900.dtb \
	nxp/imx/imx6dl-ts4900-2.dtb \
	nxp/imx/imx6dl-ts4900-14.dtb \
	nxp/imx/imx6q-ts4900.dtb \
	nxp/imx/imx6q-ts4900-2.dtb \
	nxp/imx/imx6q-ts4900-14.dtb "

MACHINE_ESSENTIAL_EXTRA_RDEPENDS += "ts4900-fpga"
MACHINE_ESSENTIAL_EXTRA_RRECOMMENDS += "udev-touchscreen-rules"
```

## conf/machine/ts7100.conf
```bitbake
include conf/machine/include/tsimx6ul.inc

KERNEL_DEVICETREE = "nxp/imx/imx6ul-ts7100-1.dtb nxp/imx/imx6ul-ts7100-3.dtb"

MACHINE_FEATURES += "screen touchscreen tssilo"

MACHINE_ESSENTIAL_EXTRA_RDEPENDS += "u-boot-distroboot-scripts"
MACHINE_ESSENTIAL_EXTRA_RRECOMMENDS += "udev-touchscreen-rules"
```

## conf/machine/ts7180.conf
```bitbake
include conf/machine/include/tsimx6ul.inc

KERNEL_DEVICETREE = "nxp/imx/imx6ul-ts7180.dtb"

MACHINE_FEATURES += "tssilo"

MACHINE_ESSENTIAL_EXTRA_RDEPENDS += "u-boot-distroboot-scripts"
MACHINE_ESSENTIAL_EXTRA_RRECOMMENDS += "wilc3000-external-module"
MACHINE_EXTRA_RRECOMMENDS += "ts7180-utils"
```

## conf/machine/ts7250v3.conf
```bitbake
include conf/machine/include/tsimx6ul.inc

KERNEL_DEVICETREE = "nxp/imx/imx6ul-ts7250v3.dtb nxp/imx/imx6ul-ts7250v3-reva.dtb"

MACHINE_ESSENTIAL_EXTRA_RDEPENDS += "u-boot-distroboot-scripts"
MACHINE_ESSENTIAL_EXTRA_RRECOMMENDS += "wilc3000-external-module"
MACHINE_EXTRA_RRECOMMENDS += "ts7100-utils"
```

## conf/machine/ts7553v2.conf
```bitbake
include conf/machine/include/tsimx6ul.inc

KERNEL_DEVICETREE = "nxp/imx/imx6ul-ts7553v2.dtb"

MACHINE_FEATURES += "tssilo"
MACHINE_ESSENTIAL_EXTRA_RRECOMMENDS += "wilc3000-external-module"
MACHINE_EXTRA_RRECOMMENDS += "ts7553v2-utils"
```

## conf/machine/ts7680.conf
```bitbake
include conf/machine/include/tsimx28.inc

KERNEL_DEVICETREE = "nxp/mxs/imx28-ts7680.dtb"

MACHINE_FEATURES += "tssilo"

WKS_FILE = "ts7680.wks"
```

## conf/machine/ts7800v2.conf
```bitbake
include conf/machine/include/tsa38x.inc

KERNEL_DEVICETREE = "marvell/armada-385-ts7800-v2.dtb"

MACHINE_ESSENTIAL_EXTRA_RRECOMMENDS += "wilc3000-external-module"
```

## conf/machine/ts7840.conf
```bitbake
include conf/machine/include/tsa38x.inc

KERNEL_DEVICETREE = "marvell/armada-385-ts7840.dtb"

MACHINE_FEATURES += "tssilo"

MACHINE_ESSENTIAL_EXTRA_RDEPENDS += "idleinject u-boot-distroboot-scripts"
```

## conf/machine/ts7970.conf
```bitbake
include conf/machine/include/tsimx6.inc

KERNEL_DEVICETREE = " \
	nxp/imx/imx6dl-ts7970.dtb \
	nxp/imx/imx6q-ts7970.dtb "

MACHINE_ESSENTIAL_EXTRA_RRECOMMENDS += "linux-firmware-ath10k \
										linux-firmware-wl12xx"
MACHINE_EXTRA_RRECOMMENDS += "ts4900-utils"
```

## conf/machine/ts7990.conf
```bitbake
include conf/machine/include/tsimx6.inc

KERNEL_DEVICETREE = " \
	nxp/imx/imx6dl-ts7990-lxd-revb.dtb \
	nxp/imx/imx6dl-ts7990-lxd.dtb \
	nxp/imx/imx6dl-ts7990-microtips-revb.dtb \
	nxp/imx/imx6dl-ts7990-microtips.dtb \
	nxp/imx/imx6dl-ts7990-okaya-revb.dtb \
	nxp/imx/imx6dl-ts7990-okaya.dtb \
	nxp/imx/imx6q-ts7990-lxd-revb.dtb \
	nxp/imx/imx6q-ts7990-lxd.dtb \
	nxp/imx/imx6q-ts7990-microtips-revb.dtb \
	nxp/imx/imx6q-ts7990-microtips.dtb \
	nxp/imx/imx6q-ts7990-okaya-revb.dtb \
	nxp/imx/imx6q-ts7990-okaya.dtb "

MACHINE_FEATURES += "tssilo"
MACHINE_ESSENTIAL_EXTRA_RRECOMMENDS += "udev-touchscreen-rules"
```

## conf/machine/ts9370.conf
```bitbake
require conf/machine/include/tsimx93.inc

KERNEL_DEVICETREE = "freescale/imx93-ts9370.dtb freescale/imx93-ts9390.dtb"

UBOOT_CONFIG_BASENAME = "ts9370"
IMXBOOT_TARGETS_BASENAME = "flash_singleboot"

DDR_FIRMWARE_NAME = " \
    lpddr4_dmem_1d_v202201.bin \
    lpddr4_dmem_2d_v202201.bin \
    lpddr4_imem_1d_v202201.bin \
    lpddr4_imem_2d_v202201.bin \
"
```
